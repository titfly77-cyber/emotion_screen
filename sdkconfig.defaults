## sdkconfig.defaults
```kconfig
# ========== Chip ==========
CONFIG_IDF_TARGET="esp32s3"

# ========== Flash ==========
CONFIG_ESPTOOLPY_FLASHSIZE_16MB=y
CONFIG_ESPTOOLPY_FLASHMODE_QIO=y

# ========== PSRAM ==========
CONFIG_SPIRAM=y
CONFIG_SPIRAM_MODE_OCT=y
CONFIG_SPIRAM_SPEED_80M=y
CONFIG_SPIRAM_TRY_ALLOCATE_WIFI_LWIP=y

# ========== CPU ==========
CONFIG_ESP_DEFAULT_CPU_FREQ_MHZ_240=y

# ========== FreeRTOS ==========
CONFIG_FREERTOS_HZ=1000

# ========== FAT filesystem ==========
CONFIG_FATFS_LONG_FILENAMES=y
CONFIG_FATFS_LFN_HEAP=y
CONFIG_FATFS_MAX_LFN=255

# ========== Log ==========
CONFIG_LOG_DEFAULT_LEVEL_INFO=y
```
